## Kconfig
```kconfig
#
# For a description of the syntax of this configuration file,
# see the file Documentation/kbuild/kconfig-language.txt in the
# Linux kernel source tree.
#
mainmenu "exynos-bl2 $(BL2VERSION) Configuration"

comment "Compiler: $(CC_VERSION_TEXT)"

source "scripts/Kconfig.include"

choice
	prompt "Boot mode select"
	default SECURE_BOOT

config NORMAL_BOOT
	bool "normal boot"

config SECURE_BOOT
	bool "secure boot"

endchoice

menu "General setup"

config BL1_SIZE
	default 0x2000 if NORMAL_BOOT
	default 0x3c00 if SECURE_BOOT
	hex "bl1 size"
	help
	  Samsung BL1 firmware size

config UBOOT_SIZE
	default 0x80000
	hex "u-boot size"
	help
	  Size of u-boot to be loaded

config UBOOT_TEXT
	default 0x43e00000
	hex "Text Base of u-boot"
	help
	  The address in memory that U-Boot will be running from, initially.

config BL2_TEXT
	default 0x02023400 if NORMAL_BOOT
	default 0x02025000 if SECURE_BOOT
	hex "Text Base of bl2"
	help
	  The address in memory that bl2 will be running from, initially.

config SP_ADDR
	default 0x02040000 if NORMAL_BOOT
	default 0x02060000 if SECURE_BOOT
	hex "Static location for the initial stack pointer"

config BL2_SIZE
	default 0x4000
	hex "exynos bl2 size"

config TZSW_SIZE
	default 0x27000
	hex "tzsw size"

config TZSW_TEXT
	default 0x02028000
	hex "Text Base of tzsw"

config SECURE_CONTEXT_BASE
	default 0x02024c00
	hex "secure signature base"

endmenu # General setup
```
